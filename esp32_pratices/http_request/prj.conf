## CMakeLists.txt
```
# SPDX-License-Identifier: Apache-2.0

cmake_minimum_required(VERSION 3.20.0)

find_package(Zephyr REQUIRED HINTS $ENV{ZEPHYR_BASE})
project(http_request)


FILE(GLOB app_sources src/*.c)

target_sources(app PRIVATE ${app_sources})
```

## prj.conf
```kconfig
# Wi-Fi Configuration
CONFIG_WIFI=y

# Network Configuration
CONFIG_NET_CONFIG_AUTO_INIT=n
CONFIG_NET_CONNECTION_MANAGER=y
CONFIG_NET_DHCPV4=y
CONFIG_NET_DHCPV4_SERVER=y
CONFIG_NET_IF_MAX_IPV4_COUNT=2
CONFIG_NET_IF_MAX_IPV6_COUNT=2
CONFIG_NET_IPV4=y
CONFIG_NET_L2_ETHERNET=y
CONFIG_NET_L2_WIFI_MGMT=y
CONFIG_NET_MGMT=y
CONFIG_NET_MGMT_EVENT=y
CONFIG_NET_MGMT_EVENT_INFO=y
CONFIG_NET_MGMT_EVENT_QUEUE_SIZE=10
CONFIG_NET_MGMT_EVENT_STACK_SIZE=4096
CONFIG_NET_PKT_RX_COUNT=16
CONFIG_NET_PKT_TX_COUNT=16
CONFIG_NET_SOCKETS_SERVICE_STACK_SIZE=4096
CONFIG_NET_TCP=y
CONFIG_NET_UDP=y
CONFIG_NETWORKING=y

# LOG Configuration
CONFIG_NET_LOG=y
CONFIG_NET_DHCPV4_SERVER_LOG_LEVEL_DBG=y
CONFIG_HTTP_CLIENT=y
```

## boards/esp32_devkitc_wroom_procpu.conf
```kconfig
CONFIG_WIFI_ESP32=y
CONFIG_ESP32_WIFI_STA_AUTO_DHCPV4=y
CONFIG_WIFI_NM=y
CONFIG_WIFI_NM_MAX_MANAGED_INTERFACES=2

CONFIG_ESP_WIFI_HEAP_SYSTEM=y
CONFIG_HEAP_MEM_POOL_SIZE=51200
```

## src/main.c
```c
/*
 *
 * Init Wifi and send a HTTP GET request to google
 *
 */

#include <zephyr/kernel.h>
#include <zephyr/logging/log.h>
#include <zephyr/net/wifi_mgmt.h>
#include <zephyr/net/dhcpv4_server.h>
#include <zephyr/net/socket.h>
#include <zephyr/net/http/client.h>
#include <string.h>
#include "wifi.h"

LOG_MODULE_REGISTER(MAIN);

/* STA Mode Configuration */
#define WIFI_SSID "LINKCE- 2G"
#define WIFI_PSK "20122000"

#define HTTP_REQUEST_HOST "google.com"
#define HTTP_REQUEST_PORT "80"

#define HTTP_RECV_BUF_LEN 512
#define HTTP_REQUEST_TIMEOUT 3000

// Globals
static uint8_t recv_buf[HTTP_RECV_BUF_LEN];

// HTTP request callback
static void response_callback(struct http_response *resp,
                              enum http_final_call final_data,
                              void *user_data)
{
    char temp_buf[HTTP_RECV_BUF_LEN + 1];

    // Check if we still have more data to receive
    if (final_data == HTTP_DATA_MORE)
    {
        printk("Partial data received (%d bytes)\r\n", resp->data_len);
    }
    else if (final_data == HTTP_DATA_FINAL)
    {
        printk("All data received (%d bytes)\r\n", resp->data_len);
    }

    // Print the received data (up to data_len bytes)
    memcpy(temp_buf, resp->recv_buf, resp->data_len);
    temp_buf[resp->data_len] = '\0';
    printk("Received data:\r\n%s\r\n", temp_buf);
}

static void print_addrinfo(struct zsock_addrinfo **results)
{
    char ipv4[INET_ADDRSTRLEN];
    char ipv6[INET6_ADDRSTRLEN];
    struct sockaddr_in *sa;
    struct sockaddr_in6 *sa6;
    struct zsock_addrinfo *rp;

    // Iterate through the results
    for (rp = *results; rp != NULL; rp = rp->ai_next)
    {

        // Print IPv4 address
        if (rp->ai_addr->sa_family == AF_INET)
        {
            sa = (struct sockaddr_in *)rp->ai_addr;
            zsock_inet_ntop(AF_INET, &sa->sin_addr, ipv4, INET_ADDRSTRLEN);
            printk("IPv4: %s\r\n", ipv4);
        }

        // Print IPv6 address
        if (rp->ai_addr->sa_family == AF_INET6)
        {
            sa6 = (struct sockaddr_in6 *)rp->ai_addr;
            zsock_inet_ntop(AF_INET6, &sa6->sin6_addr, ipv6, INET6_ADDRSTRLEN);
            printk("IPv6: %s\r\n", ipv6);
        }
    }
}

int main(void)
{
    k_sleep(K_SECONDS(3));

    // Init TCP socket
    struct zsock_addrinfo hints = {0};
    struct zsock_addrinfo *res;
    int sock;
    int ret;

    struct http_request req = {0};

    hints.ai_family = AF_INET;
    hints.ai_socktype = SOCK_STREAM;
    printk("Initing wifi...\r\n");
    wifi_init();
    connect_to_wifi(WIFI_SSID, WIFI_PSK);

    wait_wifi_connect();

    ret = zsock_getaddrinfo(HTTP_REQUEST_HOST, HTTP_REQUEST_PORT, &hints, &res);
    if (ret != 0)
    {
        printk("Error[%d]: Could not get addr info from DNS host [%s] - %s\n\r", errno, HTTP_REQUEST_HOST, strerror(errno));
        wifi_disconnect();
        return 0;
    }
    else
    {
        printk("Socket addr info collected!!\n\r");
        print_addrinfo(&res);
    }

    sock = zsock_socket(res->ai_family, res->ai_socktype, res->ai_protocol);

    memset(&req, 0, sizeof(req));
    req.method = HTTP_GET;
    req.url = "/";
    req.protocol = "HTTP/1.1";
    req.port = HTTP_REQUEST_PORT;
    req.host = HTTP_REQUEST_HOST;
    req.response = response_callback;
    req.recv_buf = recv_buf;
    req.recv_buf_len = sizeof(recv_buf);

    ret = zsock_connect(sock, res->ai_addr, res->ai_addrlen);

    if (ret < 0)
    {
        printk("Error[%d]: Socket could not connect - %s\n\r", errno, strerror(errno));
    }
    else
    {
        printk("Socket connected!!\n\r");
    }
    while (1)
    {

        ret = http_client_req(sock, &req, HTTP_REQUEST_TIMEOUT, NULL);
        if (ret >= 0)
        {
            printk("Amount of Sent data: %d\n\r", ret);
        }
        else
        {
            printk("Error to send data: %d\n\r", ret);
        }

        k_sleep(K_SECONDS(5));
    }

    zsock_close(sock);
    wifi_disconnect();

    return 0;
}
```

## src/wifi.c
```c
#include <string.h>
#include <zephyr/kernel.h>
#include <zephyr/net/wifi_mgmt.h>
#include "wifi.h"

#define WIFI_CALLBACK_FLAGS (NET_EVENT_WIFI_CONNECT_RESULT | NET_EVENT_WIFI_DISCONNECT_RESULT)

static struct net_mgmt_event_callback wifi_cb;

static K_SEM_DEFINE(wifi_connected, 0, 1);

static void wifi_event_handler(struct net_mgmt_event_callback *cb, uint32_t mgmt_event, struct net_if *iface)
{

    switch (mgmt_event)
    {
    case NET_EVENT_WIFI_CONNECT_RESULT:
        printk("Connected to wifi network!\r\n");
        k_sem_give(&wifi_connected);
        break;
    case NET_EVENT_WIFI_DISCONNECT_RESULT:
    //TODO: Implement a reconnect logic
        printk("Disconnected from the wifi network!\r\n");
        break;
    default:
        break;
    }
}


void wifi_init(void)
{
    net_mgmt_init_event_callback(&wifi_cb, wifi_event_handler, WIFI_CALLBACK_FLAGS);
    net_mgmt_add_event_callback(&wifi_cb);

}

int connect_to_wifi(char *ssid, char *psk)
{

    struct net_if *iface;
    struct wifi_connect_req_params params;
    int ret;
    iface = net_if_get_default();

    params.ssid = (const uint8_t *)ssid;
    params.ssid_length = strlen(ssid);
    params.psk = (const uint8_t *)psk;
    params.psk_length = strlen(psk);
    params.security = WIFI_SECURITY_TYPE_PSK;
    params.band = WIFI_FREQ_BAND_UNKNOWN;
    params.channel = WIFI_CHANNEL_ANY;
    params.mfp = WIFI_MFP_OPTIONAL;

    ret = net_mgmt(NET_REQUEST_WIFI_CONNECT, iface, &params, sizeof(params));
    return ret;
}


static void wifi_wait_for_ip_addr(void)
{
    struct wifi_iface_status status;
    struct net_if *iface;
    char ip_addr[NET_IPV4_ADDR_LEN];
    char gateway_addr[NET_IPV4_ADDR_LEN];
    int ret;

    iface = net_if_get_default();
    printk("Waiting for IP address");
    ret = net_mgmt(NET_REQUEST_WIFI_IFACE_STATUS, iface, &status, sizeof(struct wifi_iface_status));
    if (ret)
    {
        printk("Error to request Wifi status\r\n");
    }
    else
    {
        memset(ip_addr, 0, sizeof(ip_addr));
        if (net_addr_ntop(AF_INET, &iface->config.ip.ipv4->unicast[0].ipv4.address.in_addr, ip_addr, sizeof(ip_addr)) == NULL)
        {
            printk("Error to convert IP addr to string");
        }

        memset(gateway_addr, 0, sizeof(gateway_addr));
        if (net_addr_ntop(AF_INET, &iface->config.ip.ipv4->gw, gateway_addr, sizeof(gateway_addr)) == NULL)
        {
            printk("Error to convert Gateway IP addr to string");
        }
    }

    printk("Wifi status:\r\n");

    if (status.state >= WIFI_STATE_ASSOCIATED)
    {
        printk(" SSID: %-32s\r\n", status.ssid);
        printk(" BAND: %s\r\n", wifi_band_txt(status.band));
        printk(" CHANNEL: %d\r\n", status.channel);
        printk(" SECURITY: %s\r\n", wifi_security_txt(status.security));
        printk(" IP Addr: %s\r\n", ip_addr);
        printk(" Gateway Addr: %s\r\n", gateway_addr);
    }
}

void wait_wifi_connect(void){
    printk("Waiting for wifi connection signal\n\r");
    k_sem_take(&wifi_connected,K_FOREVER);
    wifi_wait_for_ip_addr();

    printk("Signal received!!\n\r");
}


int wifi_disconnect(void)
{
    int ret;
    struct net_if *iface = net_if_get_default();

    ret = net_mgmt(NET_REQUEST_WIFI_DISCONNECT, iface, NULL, 0);
    return ret;
}
```
