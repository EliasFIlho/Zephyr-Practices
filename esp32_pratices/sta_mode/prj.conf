## CMakeLists.txt
```
# SPDX-License-Identifier: Apache-2.0

cmake_minimum_required(VERSION 3.20.0)

find_package(Zephyr REQUIRED HINTS $ENV{ZEPHYR_BASE})
project(wifi_sta_mode)


FILE(GLOB app_sources src/*.c)

target_sources(app PRIVATE ${app_sources})
```

## prj.conf
```kconfig
CONFIG_MAIN_STACK_SIZE=4096


# Wi-Fi Configuration
CONFIG_WIFI=y


# Network Configuration
CONFIG_NET_CONFIG_AUTO_INIT=n
CONFIG_NET_CONNECTION_MANAGER=y
CONFIG_NET_DHCPV4_SERVER=y
CONFIG_NET_IF_MAX_IPV4_COUNT=2
CONFIG_NET_IF_MAX_IPV6_COUNT=2

CONFIG_NET_L2_WIFI_MGMT=y
CONFIG_NET_MGMT=y
CONFIG_NET_MGMT_EVENT=y
CONFIG_NET_MGMT_EVENT_INFO=y
CONFIG_NET_MGMT_EVENT_QUEUE_SIZE=10
CONFIG_NET_MGMT_EVENT_STACK_SIZE=4096
CONFIG_NET_PKT_RX_COUNT=20
CONFIG_NET_PKT_TX_COUNT=20
CONFIG_NET_BUF_RX_COUNT=20
CONFIG_NET_BUF_TX_COUNT=20
CONFIG_NET_MAX_CONTEXTS=10
CONFIG_NET_SOCKETS_SERVICE_STACK_SIZE=4096


CONFIG_NETWORKING=y
CONFIG_NET_IPV4=y
CONFIG_NET_TCP=y
CONFIG_NET_UDP=y
CONFIG_NET_SOCKETS=y

CONFIG_NET_L2_ETHERNET=y


# DHCP for ipv4
CONFIG_NET_DHCPV4=y

#DNS RESOLVER
CONFIG_DNS_RESOLVER=y

# Net connect timeout
CONFIG_NET_CONFIG_INIT_TIMEOUT=30




# LOG Configuration
CONFIG_NET_LOG=y
CONFIG_NET_DHCPV4_SERVER_LOG_LEVEL_DBG=y
```

## src/main.c
```c
/*
 *
 * Init Wifi and send a HTTP GET request to google
 *
 */

#include <zephyr/kernel.h>
#include <zephyr/logging/log.h>
#include <zephyr/net/wifi_mgmt.h>
#include <zephyr/net/dhcpv4_server.h>
#include "wifi.h"
#include <zephyr/net/socket.h>
#include <string.h>

LOG_MODULE_REGISTER(MAIN);

/* STA Mode Configuration */
#define WIFI_SSID "" /* Replace `SSID` with WiFi ssid. */
#define WIFI_PSK ""    /* Replace `PASSWORD` with Router password. */

#define HTTP_REQUEST_HOST "google.com"
#define HTTP_REQUEST_URL "/"

#define SOCKET_CONNECTION_MAX_ATTEMPT 3

char response[512];

int main(void)
{
    k_sleep(K_SECONDS(5));

    // Init and Connect to wifi
    wifi_init();
    connect_to_wifi(WIFI_SSID, WIFI_PSK);

    // Wait until connect (maybe use a semaphore to block)
    wait_wifi_connect();

    // Init TCP socket
    struct zsock_addrinfo hints = {0};
    struct zsock_addrinfo *res;
    int sock;

    hints.ai_family = AF_INET;
    hints.ai_socktype = SOCK_STREAM;

    int ret;
    ret = zsock_getaddrinfo(HTTP_REQUEST_HOST, "80", &hints, &res);
    if (ret != 0)
    {
        printk("Error[%d]: Could not get addr info from DNS host [%s] - %s\n\r", errno, HTTP_REQUEST_HOST, strerror(errno));
        return 0;
    }
    else
    {
        printk("Sucess get addr info from DNS host: %s\n\r", HTTP_REQUEST_HOST);
    }

    sock = zsock_socket(res->ai_family, res->ai_socktype, res->ai_protocol);

    if (sock < 0)
    {
        printk("Error[%d]: Cant create socket - %s\n\r", errno, strerror(errno));
        return 0;
    }
    else
    {
        printk("Socket created!!\n\r");
    }

    for (int i = 0; i < SOCKET_CONNECTION_MAX_ATTEMPT; i++)
    {
        ret = zsock_connect(sock, res->ai_addr, res->ai_addrlen);
        if (ret == 0)
        {
            break;
        }
        else
        {
            printk("Error[%d]: Socket could not connect - %s\n\r", errno, strerror(errno));
        }
    }

    if (ret < 0)
    {
        printk("Error[%d]: Socket could not connect - %s\n\r", errno, strerror(errno));
        return 0;
    }
    else
    {
        printk("Socket connected!!\n\r");
    }

    char request_buffer[512];

    snprintf(request_buffer, sizeof(request_buffer),
             "GET %s HTTP/1.1\r\n"
             "Host: %s\r\n"
             "Connection: close\r\n"
             "\r\n",
             HTTP_REQUEST_URL, HTTP_REQUEST_HOST);

    ret = zsock_send(sock, request_buffer, sizeof(request_buffer), 0);

    if (ret < 0)
    {
        printk("Error[%d]: Socket could not send data - %s\n\r", errno, strerror(errno));
        return 0;
    }
    else
    {
        printk("Socket sended data!!\n\r");
    }

    int len;
    int rx_total = 0;
    while (1)
    {
        len = zsock_recv(sock, response, sizeof(response) - 1, 0);

        if (len < 0)
        {
            printk("Error[%d]: Socket could not read data - %s\n\r", errno, strerror(errno));
            return 0;
        }

        if (len == 0)
        {
            break;
        }

        response[len] = '\0';
        printk("%s", response);
        rx_total += len;
    }
    printk("Total amount of bytes received: %d\n\r", rx_total);

    zsock_close(sock);
    wifi_disconnect();

    return 0;
}
```

## src/wifi.c
```c
#include <string.h>
#include <zephyr/kernel.h>
#include <zephyr/net/wifi_mgmt.h>
#include "wifi.h"

#define WIFI_CALLBACK_FLAGS (NET_EVENT_WIFI_CONNECT_RESULT | NET_EVENT_WIFI_DISCONNECT_RESULT)

static struct net_mgmt_event_callback wifi_cb;

static K_SEM_DEFINE(wifi_connected, 0, 1);

static void wifi_event_handler(struct net_mgmt_event_callback *cb, uint32_t mgmt_event, struct net_if *iface)
{

    switch (mgmt_event)
    {
    case NET_EVENT_WIFI_CONNECT_RESULT:
        printk("Connected to wifi network!\r\n");
        k_sem_give(&wifi_connected);
        break;
    case NET_EVENT_WIFI_DISCONNECT_RESULT:
    //TODO: Implement a reconnect logic
        printk("Disconnected from the wifi network!\r\n");
        break;
    default:
        break;
    }
}





void wifi_init(void)
{
    net_mgmt_init_event_callback(&wifi_cb, wifi_event_handler, WIFI_CALLBACK_FLAGS);
    net_mgmt_add_event_callback(&wifi_cb);

}

int connect_to_wifi(char *ssid, char *psk)
{

    struct net_if *iface;
    struct wifi_connect_req_params params;
    int ret;
    iface = net_if_get_default();

    params.ssid = (const uint8_t *)ssid;
    params.ssid_length = strlen(ssid);
    params.psk = (const uint8_t *)psk;
    params.psk_length = strlen(psk);
    params.security = WIFI_SECURITY_TYPE_PSK;
    params.band = WIFI_FREQ_BAND_UNKNOWN;
    params.channel = WIFI_CHANNEL_ANY;
    params.mfp = WIFI_MFP_OPTIONAL;

    ret = net_mgmt(NET_REQUEST_WIFI_CONNECT, iface, &params, sizeof(params));
    return ret;
}

void wait_wifi_connect(void){
    printk("Waiting for wifi connection signal\n\r");
    k_sem_take(&wifi_connected,K_FOREVER);
    printk("Signal received!!\n\r");
}

// void wifi_wait_for_ip_addr(void)
// {
//     struct wifi_iface_status status;
//     struct net_if *iface;
//     char ip_addr[NET_IPV4_ADDR_LEN];
//     char gateway_addr[NET_IPV4_ADDR_LEN];
//     int ret;

//     iface = net_if_get_default();
//     printk("Waiting for IP address");
//     ret = net_mgmt(NET_REQUEST_WIFI_CONNECT, iface, &status, sizeof(struct wifi_iface_status));
//     if (ret)
//     {
//         printk("Error to request Wifi status\r\n");
//     }
//     else
//     {
//         memset(ip_addr, 0, sizeof(ip_addr));
//         if (net_addr_ntop(AF_INET, &iface->config.ip.ipv4->unicast[0].ipv4.address.in_addr, ip_addr, sizeof(ip_addr)) == NULL)
//         {
//             printk("Error to convert IP addr to string");
//         }

//         memset(gateway_addr, 0, sizeof(gateway_addr));
//         if (net_addr_ntop(AF_INET, &iface->config.ip.ipv4->gw, gateway_addr, sizeof(gateway_addr)) == NULL)
//         {
//             printk("Error to convert Gateway IP addr to string");
//         }
//     }

//     printk("Wifi status:\r\n");

//     if (status.state >= WIFI_STATE_ASSOCIATED)
//     {
//         printk(" SSID: %-32s\r\n", status.ssid);
//         printk(" BAND: %s\r\n", wifi_band_txt(status.band));
//         printk(" CHANNEL: %d\r\n", status.channel);
//         printk(" SECURITY: %s\r\n", wifi_security_txt(status.security));
//         printk(" IP Addr: %s\r\n", ip_addr);
//         printk(" Gateway Addr: %s\r\n", gateway_addr);
//     }
// }

int wifi_disconnect(void)
{
    int ret;
    struct net_if *iface = net_if_get_default();

    ret = net_mgmt(NET_REQUEST_WIFI_DISCONNECT, iface, NULL, 0);
    return ret;
}
```

## src/wifi.h
```c
#pragma once

void wifi_init(void);
int connect_to_wifi(char *ssid, char *psk);
void wait_wifi_connect(void);
int wifi_disconnect(void);
```
