## esp32_pratices/stepper_motor/build/Kconfig/boards/Kconfig.esp32_devkitc
```kconfig
# Load board Kconfig descriptions.
osource "/home/elias/zephyrproject/zephyr/boards/espressif/esp32_devkitc/Kconfig.esp32_devkitc"
```

## stm32f030f4p6/7segments_driver/build/Kconfig/boards/Kconfig.defconfig
```kconfig
# Load Zephyr board defconfig descriptions.
osource "/home/elias/zephyrproject/zephyr/boards/others/stm32f030_demo/Kconfig.defconfig"
```

## stm32f030f4p6/7segments_driver/build/Kconfig/boards/Kconfig.stm32f030_demo
```kconfig
# Load board Kconfig descriptions.
osource "/home/elias/zephyrproject/zephyr/boards/others/stm32f030_demo/Kconfig.stm32f030_demo"
```

## stm32f030f4p6/7segments_driver/dts/bindings/generic,7segments.yaml
```yaml
description: "7 segments display"

compatible: "generic,7segments"

properties:
  pins:
    type: array
    required: true
```
