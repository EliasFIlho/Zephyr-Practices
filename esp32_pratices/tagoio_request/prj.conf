## prj.conf
```kconfig
CONFIG_NETWORKING=y

CONFIG_ESP32_WIFI_STA_AUTO_DHCPV4=y
CONFIG_NET_SOCKETS=y
CONFIG_ESP_WIFI_HEAP_SYSTEM=y
CONFIG_HEAP_MEM_POOL_SIZE=51200

CONFIG_MAIN_STACK_SIZE=5200
CONFIG_NET_TX_STACK_SIZE=2048
CONFIG_NET_RX_STACK_SIZE=2048

CONFIG_NET_PKT_RX_COUNT=10
CONFIG_NET_PKT_TX_COUNT=10
CONFIG_NET_BUF_RX_COUNT=20
CONFIG_NET_BUF_TX_COUNT=20
CONFIG_NET_MAX_CONTEXTS=10
CONFIG_NET_DHCPV4=y

CONFIG_NET_IPV4=y
CONFIG_NET_IPV6=n
CONFIG_DNS_RESOLVER=y
CONFIG_NET_TCP=y

CONFIG_NET_LOG=y
CONFIG_INIT_STACKS=y


CONFIG_NET_STATISTICS=y
CONFIG_NET_STATISTICS_PERIODIC_OUTPUT=n

CONFIG_WIFI=y
CONFIG_WIFI_LOG_LEVEL_ERR=y

CONFIG_NET_MGMT_EVENT_QUEUE_TIMEOUT=5000
CONFIG_NET_MGMT_EVENT_QUEUE_SIZE=16
CONFIG_HTTP_CLIENT=y
```

## src/main.c
```c
/*
 *
 * Init Wifi and send a HTTP GET request to google
 *
 */

#include <zephyr/kernel.h>
#include <zephyr/logging/log.h>
#include <zephyr/net/http/client.h>
#include <string.h>
#include "wifi.h"
#include "tagoio.h"

LOG_MODULE_REGISTER(MAIN);

/* STA Mode Configuration */
#define WIFI_SSID ""
#define WIFI_PSK ""


#define HTTP_RECV_BUF_LEN 512


// HTTP request callback
static void response_callback(struct http_response *resp,
                              enum http_final_call final_data,
                              void *user_data)
{
    char temp_buf[HTTP_RECV_BUF_LEN + 1];

    if (final_data == HTTP_DATA_MORE)
    {
        printk("Partial data received (%d bytes)\r\n", resp->data_len);
    }
    else if (final_data == HTTP_DATA_FINAL)
    {
        printk("All data received (%d bytes)\r\n", resp->data_len);
    }

    memcpy(temp_buf, resp->recv_buf, resp->data_len);
    temp_buf[resp->data_len] = '\0';
    printk("Received data:\r\n%s\r\n", temp_buf);
}

// Fake data example
static void create_data_payload(char *buffer)
{

    int rpm = 1495;
    int target = 1500;
    int error = 5;

    snprintf(buffer,174,
             "["
             "{\"variable\":\"Revolutions per minute\",\"value\":\"%d\",\"unit\":\"RPM\"},"
             "{\"variable\":\"Target\",\"value\":\"%d\",\"unit\":\"RPM\"},"
             "{\"variable\":\"Error\",\"value\":\"%d\",\"unit\":\"RPM\"}"
             "]",
             rpm, target, error);
}

int main(void)
{

    k_sleep(K_SECONDS(3));

    printk("Initing wifi...\r\n");
    wifi_init();
    connect_to_wifi(WIFI_SSID, WIFI_PSK);
    wait_wifi_connect();
    wifi_wait_for_ip_addr();


    struct tagoio data;
    memset(&data, 0, sizeof(data));

    int connect_try = 15;
    while (connect_try--)
    {
        if (tagoio_connect(&data) < 0)
        {
            printk("Error to connect to tagoio - trys count [%d]\r\n",connect_try);
        }else{
            printk("Connected\r\n");
            break;
        }
        k_msleep(250);
    }
    if(connect_try == 0){
        printk("Error to connect to tagoio");
    }
    create_data_payload(data.tagoio_payload);
    printk("Payload: \r\n%s\r\n",data.tagoio_payload);
    
    tagio_send_payload(&data,response_callback);

    k_msleep(3000);
    wifi_disconnect();

    return 0;
}
```

## src/tagoio.c
```c
#include "tagoio.h"

#include <zephyr/net/socket.h>
#include <zephyr/net/http/client.h>


#define TAGOIO_HOSTNAME "api.tago.io"
#define TAGOIO_ENDPOINT "/"
#define TAGOIO_PORT "80"

#define HTTP_REQUEST_TIMEOUT 3000

static const char *tagoio_http_headers[] = {
	"Device-Token: \"  \"\r\n",
	"Content-Type: application/json\r\n",
	"_ssl: false\r\n",
	NULL
};

static void print_addrinfo(struct zsock_addrinfo **results)
{
    char ipv4[INET_ADDRSTRLEN];
    char ipv6[INET6_ADDRSTRLEN];
    struct sockaddr_in *sa;
    struct sockaddr_in6 *sa6;
    struct zsock_addrinfo *rp;

    // Iterate through the results
    for (rp = *results; rp != NULL; rp = rp->ai_next)
    {

        // Print IPv4 address
        if (rp->ai_addr->sa_family == AF_INET)
        {
            sa = (struct sockaddr_in *)rp->ai_addr;
            zsock_inet_ntop(AF_INET, &sa->sin_addr, ipv4, INET_ADDRSTRLEN);
            printk("IPv4: %s\r\n", ipv4);
        }

        // Print IPv6 address
        if (rp->ai_addr->sa_family == AF_INET6)
        {
            sa6 = (struct sockaddr_in6 *)rp->ai_addr;
            zsock_inet_ntop(AF_INET6, &sa6->sin6_addr, ipv6, INET6_ADDRSTRLEN);
            printk("IPv6: %s\r\n", ipv6);
        }
    }
}

int tagoio_connect(struct tagoio *info)
{
    int ret;
    // Init TCP socket
    struct zsock_addrinfo hints = {0};
    struct zsock_addrinfo *res;
    hints.ai_family = AF_INET;
    hints.ai_socktype = SOCK_STREAM;
    ret = zsock_getaddrinfo(TAGOIO_HOSTNAME, TAGOIO_PORT, &hints, &res);
    if (ret != 0)
    {   
        printk("Ret value: %d",ret);
        printk("Error[%d]: Could not get addr info from DNS host [%s] - %s\r\n", errno, TAGOIO_HOSTNAME, strerror(errno));
        //wifi_disconnect();
        return -1;
    }
    else
    {
        printk("Socket addr info collected!!\n\r");
        print_addrinfo(&res);
    }
    info->socket = zsock_socket(res->ai_family, res->ai_socktype, res->ai_protocol);
    ret = zsock_connect(info->socket, res->ai_addr, res->ai_addrlen);

    if (ret < 0)
    {
        printk("Error[%d]: Socket could not connect - %s\n\r", errno, strerror(errno));
    }
    else
    {
        printk("Socket connected!!\n\r");
    }
    return ret;
}

int tagio_send_payload(struct tagoio *info,http_response_cb_t resp_cb)
{
    struct http_request req;
    memset(&req, 0, sizeof(req));


    req.method = HTTP_POST;
    req.url = TAGOIO_ENDPOINT;
    req.protocol = "HTTP/1.1";
    req.header_fields = tagoio_http_headers;
    req.port = TAGOIO_PORT;
    req.host = TAGOIO_HOSTNAME;
    req.response = resp_cb;
    req.recv_buf = info->tagoio_recv;
    req.recv_buf_len = sizeof(info->tagoio_recv);
    req.payload = info->tagoio_payload;
    req.payload_len = sizeof(info->tagoio_payload);

    return http_client_req(info->socket,&req,HTTP_REQUEST_TIMEOUT,info);



}
```

## src/tagoio.h
```c
#pragma once

#include <zephyr/net/http/client.h>

#define TAGOIO_PAYLOAD_SIZE_BYTES 512
#define TAGOIO_RECV_BUFFER_SIZE_BYTES 512
#define TAGOIO_DEVICE_ID_SIZE_BYTES 16





struct tagoio {
    char tagoio_payload[TAGOIO_PAYLOAD_SIZE_BYTES];
    char tagoio_recv[TAGOIO_RECV_BUFFER_SIZE_BYTES];
    char device_id[TAGOIO_DEVICE_ID_SIZE_BYTES];
    int socket;

};


int tagoio_connect(struct tagoio *info);
int tagio_send_payload(struct tagoio *info,http_response_cb_t resp_cb);
```

## src/wifi.h
```c
#pragma once

void wifi_init(void);
int connect_to_wifi(char *ssid, char *psk);
void wait_wifi_connect(void);
int wifi_disconnect(void);
void wifi_wait_for_ip_addr(void);
```
