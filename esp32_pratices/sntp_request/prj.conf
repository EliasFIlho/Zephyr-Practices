## prj.conf
```kconfig
CONFIG_NETWORKING=y

CONFIG_ESP32_WIFI_STA_AUTO_DHCPV4=y
CONFIG_NET_SOCKETS=y
CONFIG_ESP_WIFI_HEAP_SYSTEM=y
CONFIG_HEAP_MEM_POOL_SIZE=51200

CONFIG_MAIN_STACK_SIZE=5200
CONFIG_NET_TX_STACK_SIZE=2048
CONFIG_NET_RX_STACK_SIZE=2048

CONFIG_NET_PKT_RX_COUNT=10
CONFIG_NET_PKT_TX_COUNT=10
CONFIG_NET_BUF_RX_COUNT=20
CONFIG_NET_BUF_TX_COUNT=20
CONFIG_NET_MAX_CONTEXTS=10
CONFIG_NET_DHCPV4=y

CONFIG_NET_IPV4=y
CONFIG_DNS_RESOLVER=y
CONFIG_NET_UDP=y
CONFIG_SNTP=y

CONFIG_NET_LOG=y
CONFIG_INIT_STACKS=y


CONFIG_NET_STATISTICS=y
CONFIG_NET_STATISTICS_PERIODIC_OUTPUT=n

CONFIG_WIFI=y
CONFIG_WIFI_LOG_LEVEL_ERR=y

CONFIG_NET_MGMT_EVENT_QUEUE_TIMEOUT=5000
CONFIG_NET_MGMT_EVENT_QUEUE_SIZE=16
```

## src/main.c
```c
/*
 *
 * Init Wifi and send a HTTP GET request to google
 *
 */

#include <zephyr/kernel.h>
#include <zephyr/logging/log.h>
#include <string.h>
#include "wifi.h"
#include "sntp.h"

LOG_MODULE_REGISTER(MAIN);

/* STA Mode Configuration */
#define WIFI_SSID "LINKCE- 2G"
#define WIFI_PSK "20122000"

int main(void)
{

    k_sleep(K_SECONDS(3));
    int ret;
    printk("Initing wifi...\r\n");
    wifi_init();
    connect_to_wifi(WIFI_SSID, WIFI_PSK);
    wait_wifi_connect();
    wifi_wait_for_ip_addr();

    struct sntp_time s_time;
    ret = get_current_time(&s_time);

   

    k_msleep(3000);
    wifi_disconnect();

    return 0;
}
```

## src/sntp.c
```c
#include "sntp.h"
#include <zephyr/net/socket.h>
#include <zephyr/net/sntp.h>
#include <time.h>
#include <arpa/inet.h>

#define SNTP_HOST "a.st1.ntp.br"

int get_current_time(struct sntp_time *s_time)
{
    int ret = sntp_simple(SNTP_HOST, 4000, s_time);

    if (ret != 0)
    {
        printk("Error to do SNTP request\r\n");
    }
    else
    {
        printk("SNTP Time: %llu\r\n", s_time->seconds);
    }

    return ret;
}
```

## src/sntp.h
```c
#pragma once

#include <zephyr/net/sntp.h>



//int get_current_time(struct ntp_time *s_time);
int get_current_time(struct sntp_time *s_time);
```

## src/wifi.c
```c
#include <string.h>
#include <zephyr/kernel.h>
#include <zephyr/net/wifi_mgmt.h>
#include <zephyr/net/dhcpv4_server.h>

#include "wifi.h"

#define WIFI_CALLBACK_FLAGS (NET_EVENT_WIFI_CONNECT_RESULT | NET_EVENT_WIFI_DISCONNECT_RESULT)
#define WIFI_DHCP_CALLBACK_FLAGS (NET_EVENT_IPV4_DHCP_START | NET_EVENT_IPV4_ADDR_ADD)

static struct net_mgmt_event_callback wifi_cb;
static struct net_mgmt_event_callback ipv4_cb;

static K_SEM_DEFINE(wifi_connected, 0, 1);
static K_SEM_DEFINE(ipv4_connected, 0, 1);

static void wifi_event_handler(struct net_mgmt_event_callback *cb, uint32_t mgmt_event, struct net_if *iface)
{

    switch (mgmt_event)
    {
    case NET_EVENT_WIFI_CONNECT_RESULT:
        printk("Connected to wifi network!\r\n");
        k_sem_give(&wifi_connected);
        break;
    case NET_EVENT_WIFI_DISCONNECT_RESULT:
        // TODO: Implement a reconnect logic
        printk("Disconnected from the wifi network!\r\n");
        break;
    default:
        break;
    }
}

static void dhcp4_event_handler(struct net_mgmt_event_callback *cb, uint32_t mgmt_event, struct net_if *iface)
{
    switch (mgmt_event)
    {
    case NET_EVENT_IPV4_DHCP_START:
        printk("IPV4 Client Initied\r\n");
        break;
    case NET_EVENT_IPV4_ADDR_ADD:
        printk("Device got IPV4 address - release lock\r\n");
        k_sem_give(&ipv4_connected);
        break;
    default:
        break;
    }
}

void wifi_init(void)
{
    net_mgmt_init_event_callback(&ipv4_cb, dhcp4_event_handler, WIFI_DHCP_CALLBACK_FLAGS);
    net_mgmt_add_event_callback(&ipv4_cb);
    net_mgmt_init_event_callback(&wifi_cb, wifi_event_handler, WIFI_CALLBACK_FLAGS);
    net_mgmt_add_event_callback(&wifi_cb);
}

int connect_to_wifi(char *ssid, char *psk)
{

    struct net_if *iface;
    struct wifi_connect_req_params params;
    int ret;
    iface = net_if_get_default();

    params.ssid = (const uint8_t *)ssid;
    params.ssid_length = strlen(ssid);
    params.psk = (const uint8_t *)psk;
    params.psk_length = strlen(psk);
    params.security = WIFI_SECURITY_TYPE_PSK;
    params.band = WIFI_FREQ_BAND_UNKNOWN;
    params.channel = WIFI_CHANNEL_ANY;
    params.mfp = WIFI_MFP_OPTIONAL;

    ret = net_mgmt(NET_REQUEST_WIFI_CONNECT, iface, &params, sizeof(params));
    return ret;
}

void wifi_wait_for_ip_addr(void)
{
    struct wifi_iface_status status;
    struct net_if *iface;
    char ip_addr[NET_IPV4_ADDR_LEN];
    char gateway_addr[NET_IPV4_ADDR_LEN];
    int ret;

    iface = net_if_get_default();
    printk("Waiting for IP address");
    k_sem_take(&ipv4_connected, K_FOREVER);

    ret = net_mgmt(NET_REQUEST_WIFI_IFACE_STATUS, iface, &status, sizeof(struct wifi_iface_status));
    if (ret)
    {
        printk("Error to request Wifi status\r\n");
    }
    else
    {
        memset(ip_addr, 0, sizeof(ip_addr));
        if (net_addr_ntop(AF_INET, &iface->config.ip.ipv4->unicast[0].ipv4.address.in_addr, ip_addr, sizeof(ip_addr)) == NULL)
        {
            printk("Error to convert IP addr to string");
        }

        memset(gateway_addr, 0, sizeof(gateway_addr));
        if (net_addr_ntop(AF_INET, &iface->config.ip.ipv4->gw, gateway_addr, sizeof(gateway_addr)) == NULL)
        {
            printk("Error to convert Gateway IP addr to string");
        }
    }

    printk("Wifi status:\r\n");

    if (status.state >= WIFI_STATE_ASSOCIATED)
    {
        printk(" SSID: %-32s\r\n", status.ssid);
        printk(" BAND: %s\r\n", wifi_band_txt(status.band));
        printk(" CHANNEL: %d\r\n", status.channel);
        printk(" SECURITY: %s\r\n", wifi_security_txt(status.security));
        printk(" IP Addr: %s\r\n", ip_addr);
        printk(" Gateway Addr: %s\r\n", gateway_addr);
    }
}

void wait_wifi_connect(void)
{
    printk("Waiting for wifi connection signal\n\r");
    k_sem_take(&wifi_connected, K_FOREVER);
}

int wifi_disconnect(void)
{
    int ret;
    struct net_if *iface = net_if_get_default();

    ret = net_mgmt(NET_REQUEST_WIFI_DISCONNECT, iface, NULL, 0);
    return ret;
}
```
